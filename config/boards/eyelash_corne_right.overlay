&nice_view_spi {
    status = "okay";
};

/ {
    EXT_POWER: EXT_POWER {
        compatible = "zmk,ext-power-generic";
        control-gpios = <&gpio0 13 GPIO_ACTIVE_HIGH>;
        init-delay-ms = <50>;
    };
};
