## config/west.yml
```yaml
manifest:
  remotes:
    - name: zmkfirmware
      url-base: https://github.com/zmkfirmware
    - name: eyelash
      url-base: https://github.com/a741725193
    - name: zzeneg
      url-base: https://github.com/zzeneg
    - name: srwi
      url-base: https://github.com/srwi
  projects:
    - name: zmk-board-eyelash
      remote: eyelash
      revision: main
    - name: zmk-new_corne
      remote: eyelash
      revision: main
    - name: zmk
      remote: zmkfirmware
      revision: v0.3.0
      import: app/west.yml
    - name: zmk-raw-hid
      remote: zzeneg
      revision: main
    - name: zmk-keypeek-layer-notifier
      remote: srwi
      revision: master
  self:
    path: config
```
